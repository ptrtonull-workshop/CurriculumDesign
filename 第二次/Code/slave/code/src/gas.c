#include <reg52.h> // 库文件
#include <gas.h> // 库文件
#define uchar unsigned char// 宏定义无符号字符型
#define uint unsigned int // 宏定义无符号整型

/********************************************************************
I/O 定义
*********************************************************************/
sbit LED=P1^0; // 定义单片机P1 口的第1 位（即P1.0 ）为指示端
sbit DOUT=P2^0; // 定义单片机P2 口的第1 位（即P2.0 ）为传感器的输入端
int flag;
/********************************************************************
延时函数
*********************************************************************/
void Gdelay()// 延时程序
{
	uchar m,n,s;
	for(m=20;m>0;m--)
	for(n=20;n>0;n--)
	for(s=248;s>0;s--);
}
/********************************************************************
函数
*********************************************************************/
int Gas()
{
		flag =0; // 熄灭P1.0 口灯
		if(DOUT==0)// 当浓度高于设定值时，执行条件函数
		{
			Gdelay();// 延时抗干扰
			if(DOUT==0)// 确定浓度高于设定值时，执行条件函数
			{
				flag =1; // 点亮P1.0 口灯
			}
		}
		return flag;
}
